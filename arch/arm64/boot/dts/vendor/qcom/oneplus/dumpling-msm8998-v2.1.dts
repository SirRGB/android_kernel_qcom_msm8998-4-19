/* Copyright (c) 2016-2017, The Linux Foundation. All rights reserved.
 * Copyright (c) 2023, Edrick Vince Sinsuan <sedrickvince@gmail.com>
 *
 * This program is free software; you can redistribute it and/or modify
 * it under the terms of the GNU General Public License version 2 and
 * only version 2 as published by the Free Software Foundation.
 *
 * This program is distributed in the hope that it will be useful,
 * but WITHOUT ANY WARRANTY; without even the implied warranty of
 * MERCHANTABILITY or FITNESS FOR A PARTICULAR PURPOSE.  See the
 * GNU General Public License for more details.
 */

/dts-v1/;

#include "../msm8998-v2.1.dtsi"
#include "msm8998-oneplus-panel-supply.dtsi"
#include "msm8998-oneplus-pinctrl.dtsi"
#include "dumpling.dtsi"
#include "dumpling-pvt.dtsi"

/ {
	model = "OnePlus dumpling (MSM8998 v2.1)";
	compatible = "qcom,msm8998-mtp", "qcom,msm8998", "qcom,mtp";
	qcom,board-id = <8 0 17801 43>;
};
