## drivers/gpu/msm/Kconfig
```kconfig
# SPDX-License-Identifier: GPL-2.0-only
config QCOM_KGSL
	tristate "Qualcomm Technologies, Inc. 3D Graphics driver"
	depends on ARCH_QCOM
	depends on QCOM_QFPROM
	select GENERIC_ALLOCATOR
	select FW_LOADER
	select PM_DEVFREQ
	select QCOM_SCM
	select DEVFREQ_GOV_SIMPLE_ONDEMAND
	select DEVFREQ_GOV_PERFORMANCE
	select DEVFREQ_GOV_QCOM_ADRENO_TZ
	select DEVFREQ_GOV_QCOM_GPUBW_MON
	help
	  3D graphics driver for the Adreno family of GPUs from QTI.
	  Required to use hardware accelerated OpenGL, compute and Vulkan
	  on QTI targets. This includes power management, memory management,
	  and scheduling for the Adreno GPUs.

config QCOM_ADRENO_DEFAULT_GOVERNOR
	string "devfreq governor for the adreno core"
	default "msm-adreno-tz" if DEVFREQ_GOV_QCOM_ADRENO_TZ
	default "simple_ondemand"
	depends on QCOM_KGSL

config QCOM_KGSL_IOMMU
	bool
	default y if QCOM_KGSL && (MSM_IOMMU || ARM_SMMU)

config CORESIGHT_ADRENO
	bool
	default y if QCOM_KGSL=y && CORESIGHT=y

config KGSL_OP5_DIAG
	bool "Temporary OP5 V12 bounded KGSL metadata diagnostics"
	depends on QCOM_KGSL=y
	default n
	help
	  Log bounded SurfaceFlinger memory lifetime, submission metadata and
	  first fault counters. Does not read command contents or alter GPU
	  behavior. Diagnostic output includes GPU virtual addresses.
```

## drivers/input/fingerprint/Kconfig
```kconfig
menuconfig INPUT_FINGERPRINT
	bool "Fingerprint"
	depends on ARCH_ONEPLUS_MSM8998
	help
	  Say Y here, and a list of supported fingerprint will be displayed.
	  This option doesn't affect the kernel.

	  If unsure, say Y.

if INPUT_FINGERPRINT

config FINGERPRINT_DETECT
	bool "OnePlus fingerprint sensor detection"

config FINGERPRINT_FPC
	bool "FPC fingerprint sensor support"

config FINGERPRINT_GOODIX
	bool "Goodix fingerprint sensor support"
endif
```

## drivers/platform/oneplus/Kconfig
```kconfig
# OnePlus configuration options

config MACH_ONEPLUS
	bool "OnePlus board"
	depends on ARCH_QCOM
	help
	 Support for OnePlus boards.

config MACH_ONEPLUS_MSM8998
	bool "OnePlus MSM8998 boards"
	depends on ARCH_MSM8998
	select MACH_ONEPLUS
	help
	 Support for MSM8998 OnePlus boards.
```

## drivers/switch/Kconfig
```kconfig
config SWITCH
	bool "Switch class support"
	help
	  Say Y here to enable the legacy Android switch class. This allows
	  switch state monitoring from userspace through sysfs and uevents.
```
